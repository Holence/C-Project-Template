## examples/complex-example/Kconfig
```kconfig
config USE_LIBA
    bool "Use liba"

config USE_LIBB
    bool "Use libb"

source "scripts/Kconfig.compiler"
```

## examples/full-example-kconfig/Kconfig
```kconfig
config ASM_STRING
	string "greeting string used in asmfuncs.S"
	default "Greetings sire!"

config C_HEX
	hex "hex used in cfuncs.c"
	default 0xC

config CPP_FLOAT
	int "float used in cppfuncs.cpp"
	default 114514
	help
		Kconfig don't have float type
		Enter your floating-point number multiplied by 1000
		For example, 114.514 -> 114514

config THREAD_NUM
	int "Thread Worker Number"
	default 8

source "scripts/Kconfig.compiler"
```

## examples/hello-world-kconfig/Kconfig
```kconfig
config MY_NAME
	string "My name"
	default "Holence"

source "scripts/Kconfig.compiler"
source "utils/Kconfig"
```

## examples/lib-example/libmymath/Kconfig
```kconfig
config VERSION
    string "version"
    default "V114.514"

source "scripts/Kconfig.compiler"
```

## scripts/Kconfig.compiler
```kconfig
# Copyright (C) 2025 Holence <Holence08@gmail.com>

menu "Compiler Options"

	menu "CC Options"
		choice
			prompt "Optimization Level"
			default CC_O2
			config CC_O0
				bool "O0"
			config CC_O1
				bool "O1"
			config CC_O2
				bool "O2"
			config CC_O3
				bool "O3"
			config CC_Os
				bool "Os"
		endchoice

		config CC_OPT
			string
			default "-O0" if CC_O0
			default "-O1" if CC_O1
			default "-O2" if CC_O2
			default "-O3" if CC_O3
			default "-Os" if CC_Os
			default ""
		
		menu "Sanitizers"
			config CC_SANITIZE_UNDEFINED
				bool "Enable UndefinedBehaviorSanitizer (-fsanitize=undefined)"
				default n
				help
					A fast undefined behavior detector

			config CC_SANITIZE_ADDRESS
				bool "Enable AddressSanitizer (-fsanitize=address)"
				default n
				depends on !CC_SANITIZE_THREAD
				select CC_DEBUG
				help
					A fast memory error detector

					This option cannot be combined with -fsanitize=thread or -fsanitize=hwaddress

					When compiling with -fsanitize=address, you should also use -g to produce
					more meaningful output
					
					And don't use this with valgrind!

			config CC_SANITIZE_LEAK
				bool "Enable LeakSanitizer (-fsanitize=leak)"
				default n
				depends on !CC_SANITIZE_THREAD
				help
					A memory leak detector

					This option cannot be combined with -fsanitize=thread
					
					And don't use this with valgrind!
		
			config CC_SANITIZE_THREAD
				bool "Enable ThreadSanitizer (-fsanitize=thread)"
				default n
				help
					A fast data race detector

					This option cannot be combined with -fsanitize=address, -fsanitize=leak

					And don't use this with valgrind!
		endmenu

		config CC_DEBUG
			bool "Enable debug information (-Og -ggdb3)"
			default n

		config CC_LTO
			bool "Enable link-time optimization (-flto)"
			default y

		config CC_ANALYZER
			bool "Enable static analysis (-fanalyzer)"
			default n
	endmenu

	config GENERATE_PREPROCESSED
		bool "Also generate preprocessed files (-E)"
		default n

endmenu
```

## utils/Kconfig
```kconfig
menu "Debug"

	config ENABLE_DEBUG_LOGGING
			bool "Enable Debug related Logging"
			default y
			help
				enable Log, Debug, Error in debug.h

	config ENABLE_DEBUG_ASSERT
			bool "Enable Debug related Assert"
			default y
			help
				enable Assert, Require, TODO in debug.h

endmenu
```
